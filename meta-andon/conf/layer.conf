## meta-andon/conf/layer.conf
```bitbake
# Capa propia del proyecto Estación Andon Inteligente de Borde
BBPATH .= ":${LAYERDIR}"

BBFILES += "${LAYERDIR}/recipes-*/*/*.bb \
            ${LAYERDIR}/recipes-*/*/*.bbappend"

BBFILE_COLLECTIONS += "meta-andon"
BBFILE_PATTERN_meta-andon = "^${LAYERDIR}/"
BBFILE_PRIORITY_meta-andon = "10"

LAYERDEPENDS_meta-andon = "core openembedded-layer meta-python networking-layer raspberrypi"
LAYERSERIES_COMPAT_meta-andon = "scarthgap"
```
